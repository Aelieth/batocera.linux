## package/batocera/sneshd/sneshd-admin/Config.in
```kconfig
config BR2_PACKAGE_SNESHD_ADMIN
	bool "sneshd-admin"
	help
	  SNES-HD admin tools: reset cart game options, restore host
	  batocera.conf, and format a USB disk as a SNES-<id> cart.
```

## package/batocera/sneshd/sneshd-cart/Config.in
```kconfig
config BR2_PACKAGE_SNESHD_CART
	bool "sneshd-cart"
	help
	  SNES-HD cartridge manager. Discovers BTRFS volumes by label
	  (SHARE, SNES, SNES-*, SAVES), bind-mounts a cart session or
	  falls back to admin on SHARE, and hard-powers-off on yank.
```

## package/batocera/sneshd/sneshd-plymouth/Config.in
```kconfig
config BR2_PACKAGE_SNESHD_PLYMOUTH
	bool "sneshd-plymouth"
	help
	  SNES-HD Plymouth theme (snes-load) lifted from SNES/rootfs.cpio.
	  Data only — does not pull a glibc plymouthd onto the OS.
	  The uClibc-ng plymouthd lives in the thin initramfs (Phase 6).
```

## package/batocera/sneshd/sneshd-system/Config.in
```kconfig
config BR2_PACKAGE_BATOCERA_SNESHD
	bool "SNES-HD SNES-family image"
	select BR2_PACKAGE_BATOCERA_RETROARCH
	select BR2_PACKAGE_LIBRETRO_BSNES
	select BR2_PACKAGE_LIBRETRO_BSNES_HD
	select BR2_PACKAGE_LIBRETRO_SNES9X
	select BR2_PACKAGE_LIBRETRO_MESENS
	select BR2_PACKAGE_SNESHD_CART
	select BR2_PACKAGE_SNESHD_ADMIN
	select BR2_PACKAGE_SNESHD_PLYMOUTH
	# Sinden only — not the full BATOCERA_GUNS umbrella (Aimtrak, Gun4IR, …)
	select BR2_PACKAGE_SINDEN_GUNS
	select BR2_PACKAGE_LIGHTGUNS_GAMES_PRECALIBRATIONS
	select BR2_PACKAGE_HOST_BTRFS_PROGS
	help
	  SNES-HD console package set. Turns off Batocera's all-systems
	  umbrella and keeps only the Super Nintendo family:

	    snes, snes-msu1, satellaview, sufami, sgb, sgb-msu1

	  Default core is libretro bsnes-hd (DerKoun, ARM64) at 3x Mode 7.
	  Sinden is selected here; BATOCERA_GUNS is gated off in SYSTEM.
	  Do not select this on stock bcm2712.
```
